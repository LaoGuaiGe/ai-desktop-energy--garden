## lvgl9.5-demo/sdkconfig.defaults.esp32s3
```kconfig
# 🚀 ESP32-S3 立创实战派开发板 配置
# SPDX-FileCopyrightText: 2025
# SPDX-License-Identifier: Apache-2.0

# PSRAM 配置 (ESP32-S3-WROOM-1 N16R8)
CONFIG_SPIRAM=y
CONFIG_SPIRAM_SPEED_80M=y

# 编译器优化
CONFIG_COMPILER_OPTIMIZATION_PERF=y

# FreeRTOS 配置
CONFIG_ESP_TASK_WDT_EN=n
CONFIG_FREERTOS_HZ=1000
CONFIG_FREERTOS_TIMER_TASK_STACK_DEPTH=4096

# LVGL 配置
CONFIG_ESP_LVGL_ADAPTER_ENABLE_FPS_STATS=y
CONFIG_LV_OS_FREERTOS=y
CONFIG_LV_USE_CLIB_MALLOC=y
CONFIG_LV_USE_CLIB_STRING=y
CONFIG_LV_USE_CLIB_SPRINTF=y
CONFIG_LV_DEF_REFR_PERIOD=15
CONFIG_LV_OBJ_STYLE_CACHE=y
CONFIG_LV_DRAW_SW_DRAW_UNIT_CNT=2
CONFIG_LV_USE_DEMO_WIDGETS=y
```
